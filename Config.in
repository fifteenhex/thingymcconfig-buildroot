## Config.in
```kconfig
source "$BR2_EXTERNAL_THINGYMCCONFIG_PATH/package/thingymcconfig/Config.in"
source "$BR2_EXTERNAL_THINGYMCCONFIG_PATH/package/thingymcconfig-exampleapp/Config.in"
```

## package/thingymcconfig-exampleapp/Config.in
```kconfig
config BR2_PACKAGE_THINGYMCCONFIG_EXAMPLEAPP
	bool "build example app"
	depends on BR2_PACKAGE_THINGYMCCONFIG
	select BR2_PACKAGE_LIBOPING
	help
	  Example application for thingymcconfig
```

## package/thingymcconfig/Config.in
```kconfig
config BR2_PACKAGE_THINGYMCCONFIG
	bool "thingymcconfig"
	select BR2_PACKAGE_LIBMICROHTTPD
	select BR2_PACKAGE_LIBMICROHTTPD_SSL
	select BR2_PACKAGE_JSON_GLIB
	select BR2_PACKAGE_LIBNL
	select BR2_PACKAGE_WPA_SUPPLICANT
	select BR2_PACKAGE_WPA_SUPPLICANT_AP_SUPPORT
	help
	  Provisioning and configuration for Linux based things
```
